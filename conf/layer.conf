## conf/layer.conf
```bitbake
# We have a conf and classes directory, add to BBPATH
BBPATH .= ":${LAYERDIR}"

# We have recipes-* directories, add to BBFILES
BBFILES += "${LAYERDIR}/recipes-*/*/*.bb \
        ${LAYERDIR}/recipes-*/*/*.bbappend"

BBFILE_COLLECTIONS += "ocaml-layer"
BBFILE_PATTERN_ocaml-layer = "^${LAYERDIR}/"
BBFILE_PRIORITY_ocaml-layer = "6"

#LAYERDEPENDS_ocaml-layer = ""

LAYERSERIES_COMPAT_ocaml-layer = "sumo dunfell"
```
